## boards/arm/ixkb/ixkb_defconfig
```kconfig
# SPDX-License-Identifier: MIT

CONFIG_SOC_SERIES_NRF52X=y
CONFIG_SOC_NRF52840_QIAA=y
CONFIG_BOARD_IXKB=y

CONFIG_ZMK_USB=y
CONFIG_ZMK_BLE=y

# Enable MPU
CONFIG_ARM_MPU=y

# enable GPIO
CONFIG_GPIO=y
CONFIG_SPI=y
CONFIG_PINCTRL=y
CONFIG_ZMK_KSCAN_MATRIX_POLLING=y
CONFIG_GPIO_595=y

# encoder
CONFIG_EC11=y
CONFIG_EC11_TRIGGER_GLOBAL_THREAD=y

# enable mouse through joystick
CONFIG_INPUT_ANALOG_JOYSTICK=y

CONFIG_USE_DT_CODE_PARTITION=y
CONFIG_BUILD_OUTPUT_UF2=y

CONFIG_MPU_ALLOW_FLASH_WRITE=y
CONFIG_NVS=y
CONFIG_SETTINGS_NVS=y
CONFIG_FLASH=y
CONFIG_FLASH_PAGE_LAYOUT=y
CONFIG_FLASH_MAP=y
CONFIG_CLOCK_CONTROL_NRF=y
CONFIG_CLOCK_CONTROL_NRF_K32SRC_RC=y

CONFIG_BT_DEVICE_NAME="ixkb"
CONFIG_BT_DIS_PNP_VID=0x1D50
CONFIG_BT_DIS_PNP_PID=0x615F
#CONFIG_HAS_POWEROFF=y
#CONFIG_ZMK_SLEEP=y
CONFIG_ZMK_BLE_EXPERIMENTAL_CONN=y

CONFIG_BT_CTLR_TX_PWR_PLUS_8=y

CONFIG_LOG=y
CONFIG_ZMK_USB_LOGGING=y
CONFIG_USB_CDC_ACM_RINGBUF_SIZE=16384
CONFIG_LOG_BUFFER_SIZE=16384
CONFIG_ZMK_LOG_LEVEL_DBG=y
# CONFIG_GPIO_LOG_LEVEL_DBG=y
# CONFIG_BT_LOG_LEVEL_DBG=y
CONFIG_SENSOR_LOG_LEVEL_DBG=y
CONFIG_LOG_PROCESS_THREAD_STARTUP_DELAY_MS=4000
CONFIG_ADC_LOG_LEVEL_DBG=y

CONFIG_ZMK_HID_CONSUMER_REPORT_USAGES_BASIC=y
CONFIG_SENSOR=y

CONFIG_USB_NRFX=y
CONFIG_USB_DEVICE_STACK=y
```

## config/boards/arm/ixkb/Kconfig.board
```kconfig
# ixkb board configuration

# Copyright (c) 2020 The ZMK Contributors
# SPDX-License-Identifier: MIT

config BOARD_IXKB
    bool "ixkb"
    depends on SOC_NRF52840_QIAA
```

## config/boards/arm/ixkb/Kconfig.defconfig
```kconfig
# Electronut Labs Papyr board configuration

# Copyright (c) 2020 The ZMK Contributors
# SPDX-License-Identifier: MIT

if BOARD_IXKB

config ZMK_KEYBOARD_NAME
    default "IXKB"

config BOARD
    default "ixkb"

if USB_DEVICE_STACK

config USB_NRFX
    default y

endif # USB_DEVICE_STACK

config BT_CTLR
    default BT

endif # BOARD_IXKB
```

## config/boards/arm/ixkb/ixkb_defconfig
```kconfig
# SPDX-License-Identifier: MIT

CONFIG_SOC_SERIES_NRF52X=y
CONFIG_SOC_NRF52840_QIAA=y
CONFIG_BOARD_IXKB=y

# Enable MPU
CONFIG_ARM_MPU=y

# enable GPIO
CONFIG_GPIO=y
CONFIG_SPI=y
CONFIG_PINCTRL=y
CONFIG_ZMK_KSCAN_MATRIX_POLLING=y
CONFIG_GPIO_595=y

# encoder
CONFIG_EC11=y
CONFIG_EC11_TRIGGER_GLOBAL_THREAD=y

# joystick
# CONFIG_JOYSTICK=y
# CONFIG_JOYSTICK_THB=y
# CONFIG_JOYSTICK_THB_TRIGGER_SYSTEM_QUEUE=y
# CONFIG_JOYSTICK_THB_TRIGGER_DEDICATED_QUEUE=y

CONFIG_USE_DT_CODE_PARTITION=y
CONFIG_BUILD_OUTPUT_UF2=y

CONFIG_MPU_ALLOW_FLASH_WRITE=y
CONFIG_NVS=y
CONFIG_SETTINGS_NVS=y
CONFIG_FLASH=y
CONFIG_FLASH_PAGE_LAYOUT=y
CONFIG_FLASH_MAP=y
CONFIG_CLOCK_CONTROL_NRF=y
CONFIG_CLOCK_CONTROL_NRF_K32SRC_RC=y

CONFIG_ZMK_USB=y
CONFIG_ZMK_BLE=y

CONFIG_BT_CTLR_TX_PWR_PLUS_8=y

CONFIG_LOG=y
CONFIG_ZMK_USB_LOGGING=y
CONFIG_USB_CDC_ACM_RINGBUF_SIZE=32768
CONFIG_LOG_BUFFER_SIZE=32768
CONFIG_ZMK_LOG_LEVEL_DBG=y
CONFIG_GPIO_LOG_LEVEL_DBG=y
CONFIG_BT_LOG_LEVEL_DBG=y
CONFIG_SENSOR_LOG_LEVEL_DBG=y
CONFIG_LOG_PROCESS_THREAD_STARTUP_DELAY_MS=4000

CONFIG_ZMK_HID_CONSUMER_REPORT_USAGES_BASIC=y
CONFIG_HEAP_MEM_POOL_SIZE=32768
CONFIG_SENSOR=y

CONFIG_USB_NRFX=y
CONFIG_USB_DEVICE_STACK=y
```

## config/west.yml
```yaml
manifest:
  remotes:
    - name: zmkfirmware
      url-base: https://github.com/zmkfirmware
    - name: friggeri
      url-base: https://github.com/friggeri
  projects:
    - name: zmk
      remote: friggeri
      revision: feat/hid-joystick
      import: app/west.yml
    - name: zmk-analog-joystick-driver
      remote: friggeri
      revision: main
    - name: zmk-joystick-listener
      remote: friggeri
      revision: main
  self:
    path: config
```
